/*
 * ML-KEM benchmarks on the ESP32-S3, with a classical baseline.
 *
 * Radio-free by construction: this build never initialises Wi-Fi, so no
 * retransmission, power-management transition or network task lands inside a
 * measurement window. The price is that the hardware RNG has no guaranteed
 * entropy source (docs/hardware.md), which is why every operation here uses the
 * *_derand API with fixed inputs. That is the right choice for a benchmark
 * anyway - fixed inputs make runs comparable.
 *
 * Nothing measured here is a security claim. Keys generated by this build are
 * bench material and never leave it.
 */

#include <inttypes.h>
#include <stdio.h>
#include <string.h>

#include "esp_chip_info.h"
#include "esp_heap_caps.h"
#include "esp_memory_utils.h"
#include "freertos/FreeRTOS.h"
#include "freertos/task.h"
#include "mbedtls/bignum.h"
#include "mbedtls/ecdh.h"
#include "mbedtls/ecp.h"

#include "bench.h"
#include "mlkem_native_all.h"

#define ITERATIONS 50
#define CPU_MHZ CONFIG_ESP_DEFAULT_CPU_FREQ_MHZ

/* ------------------------------------------------------------- ML-KEM state -- */

static uint8_t s_coins[2 * MLKEM_SYMBYTES];
static uint8_t s_msg[MLKEM_SYMBYTES];

static uint8_t s_pk512[MLKEM512_PUBLICKEYBYTES];
static uint8_t s_sk512[MLKEM512_SECRETKEYBYTES];
static uint8_t s_ct512[MLKEM512_CIPHERTEXTBYTES];

static uint8_t s_pk768[MLKEM768_PUBLICKEYBYTES];
static uint8_t s_sk768[MLKEM768_SECRETKEYBYTES];
static uint8_t s_ct768[MLKEM768_CIPHERTEXTBYTES];

static uint8_t s_ss[MLKEM_BYTES];

static void fill_pattern(uint8_t *buf, size_t len, uint8_t seed)
{
    for (size_t i = 0; i < len; i++) {
        buf[i] = (uint8_t)(seed + i * 7u);
    }
}

/*
 * Return values are checked, not discarded. mlkem-native marks its API
 * warn_unused_result for good reason: an operation that bails out early is fast,
 * and timing the failure path while reporting it as a result would be the
 * quietest possible way to publish a wrong number.
 */
static volatile int s_op_failures;

#define CHECKED(call)                                                          \
    do {                                                                       \
        if ((call) != 0) {                                                     \
            s_op_failures++;                                                   \
        }                                                                      \
    } while (0)

static void op_kem512_keygen(void)
{
    CHECKED(mlkem512_keypair_derand(s_pk512, s_sk512, s_coins));
}
static void op_kem512_encaps(void)
{
    CHECKED(mlkem512_enc_derand(s_ct512, s_ss, s_pk512, s_msg));
}
static void op_kem512_decaps(void)
{
    CHECKED(mlkem512_dec(s_ss, s_ct512, s_sk512));
}

static void op_kem768_keygen(void)
{
    CHECKED(mlkem768_keypair_derand(s_pk768, s_sk768, s_coins));
}
static void op_kem768_encaps(void)
{
    CHECKED(mlkem768_enc_derand(s_ct768, s_ss, s_pk768, s_msg));
}
static void op_kem768_decaps(void)
{
    CHECKED(mlkem768_dec(s_ss, s_ct768, s_sk768));
}

/* ------------------------------------------------------- classical baseline -- */

static mbedtls_ecp_group s_grp;
static mbedtls_mpi s_d, s_z;
static mbedtls_ecp_point s_Q, s_Qpeer;

/*
 * Deterministic stand-in for a CSPRNG. Legitimate here and only here: this build
 * has no trustworthy entropy source by design, and a benchmark wants repeatable
 * inputs. Nothing produced with it is used to protect anything.
 */
static int det_rng(void *ctx, unsigned char *out, size_t len)
{
    static uint8_t counter = 0x3c;
    (void)ctx;
    for (size_t i = 0; i < len; i++) {
        out[i] = (uint8_t)(counter += 0x61);
    }
    return 0;
}

static void op_x25519_keygen(void)
{
    CHECKED(mbedtls_ecdh_gen_public(&s_grp, &s_d, &s_Q, det_rng, NULL));
}

static void op_x25519_derive(void)
{
    CHECKED(mbedtls_ecdh_compute_shared(&s_grp, &s_z, &s_Qpeer, &s_d, det_rng,
                                        NULL));
}

/*
 * The same exchange through mbedtls's ecdh *context* API rather than the raw ECP
 * functions above.
 *
 * This exists to close an obvious objection. mbedtls can route Curve25519 to the
 * Everest implementation, which is far faster than the generic bignum path - but
 * only through the context API, and only when that variant is compiled in.
 * ESP-IDF does not compile it: libeverest.a in this build contains zero defined
 * functions. Measuring both APIs shows the figure is a property of the platform,
 * not of which entry point was called.
 *
 * One full exchange: both sides' key generation plus both sides' shared secret.
 * That makes it directly comparable to ML-KEM keygen + encaps + decaps.
 */
static uint8_t s_ecdh_buf[128];
static uint8_t s_ecdh_pub[128];
static uint8_t s_ecdh_secret[32];

static void op_x25519_full_exchange(void)
{
    mbedtls_ecdh_context a, b;
    size_t olen = 0, plen = 0, slen = 0;

    mbedtls_ecdh_init(&a);
    mbedtls_ecdh_init(&b);

    int rc = mbedtls_ecdh_setup(&a, MBEDTLS_ECP_DP_CURVE25519);
    if (rc == 0) {
        rc = mbedtls_ecdh_make_params(&a, &olen, s_ecdh_buf, sizeof(s_ecdh_buf),
                                      det_rng, NULL);
    }
    if (rc == 0) {
        const unsigned char *ptr = s_ecdh_buf;
        rc = mbedtls_ecdh_read_params(&b, &ptr, s_ecdh_buf + olen);
    }
    if (rc == 0) {
        rc = mbedtls_ecdh_make_public(&b, &plen, s_ecdh_pub, sizeof(s_ecdh_pub),
                                      det_rng, NULL);
    }
    if (rc == 0) {
        rc = mbedtls_ecdh_read_public(&a, s_ecdh_pub, plen);
    }
    if (rc == 0) {
        rc = mbedtls_ecdh_calc_secret(&a, &slen, s_ecdh_secret,
                                      sizeof(s_ecdh_secret), det_rng, NULL);
    }
    if (rc == 0) {
        rc = mbedtls_ecdh_calc_secret(&b, &slen, s_ecdh_secret,
                                      sizeof(s_ecdh_secret), det_rng, NULL);
    }

    mbedtls_ecdh_free(&a);
    mbedtls_ecdh_free(&b);
    CHECKED(rc);
}

static bool classical_setup(void)
{
    mbedtls_ecp_group_init(&s_grp);
    mbedtls_mpi_init(&s_d);
    mbedtls_mpi_init(&s_z);
    mbedtls_ecp_point_init(&s_Q);
    mbedtls_ecp_point_init(&s_Qpeer);

    if (mbedtls_ecp_group_load(&s_grp, MBEDTLS_ECP_DP_CURVE25519) != 0) {
        printf("X25519 unavailable in this mbedtls configuration\n");
        return false;
    }

    mbedtls_mpi peer_d;
    mbedtls_mpi_init(&peer_d);
    int rc = mbedtls_ecdh_gen_public(&s_grp, &peer_d, &s_Qpeer, det_rng, NULL);
    mbedtls_mpi_free(&peer_d);
    if (rc != 0) {
        printf("X25519 peer key generation failed (%d)\n", rc);
        return false;
    }

    return mbedtls_ecdh_gen_public(&s_grp, &s_d, &s_Q, det_rng, NULL) == 0;
}

/* --------------------------------------------------------------------- main -- */

static void report_environment(void)
{
    esp_chip_info_t info;
    esp_chip_info(&info);

    printf("\n=== benchmark environment ===\n");
    printf("chip           : ESP32-S3 rev v%d.%d, %d core(s)\n",
           info.revision / 100, info.revision % 100, info.cores);
    printf("cpu frequency  : %d MHz\n", CPU_MHZ);
    printf("freertos tick  : %d Hz\n", CONFIG_FREERTOS_HZ);
    printf("radio          : never initialised\n");
    printf("randomness     : fixed inputs via the _derand API\n");
    printf("mlkem-native   : v2.0.0, portable C, no native backend\n");
    printf("internal free  : %u bytes\n",
           (unsigned)heap_caps_get_free_size(MALLOC_CAP_INTERNAL));

    /* The invariant every number below depends on. */
    void *probe = malloc(8192);
    printf("buffer placement: %s\n",
           (probe && esp_ptr_internal(probe)) ? "internal SRAM (ok)"
                                             : "NOT internal SRAM - INVALID");
    free(probe);
}

static void run_one(const char *name, bench_op_t op)
{
    bench_result_t r;
    s_op_failures = 0;

    if (!bench_measure(name, op, ITERATIONS, &r)) {
        printf("%-26s harness error\n", name);
        return;
    }
    r.stack_bytes = bench_stack_usage(op);

    if (s_op_failures != 0) {
        printf("%-26s %d call(s) returned an error - NOT REPORTING\n", name,
               s_op_failures);
        return;
    }
    bench_print(&r);
}

void app_main(void)
{
    vTaskDelay(pdMS_TO_TICKS(200));

    report_environment();

    fill_pattern(s_coins, sizeof(s_coins), 0xa1);
    fill_pattern(s_msg, sizeof(s_msg), 0xb2);

    /* Prepare the inputs each operation needs, outside the measured region. */
    if (mlkem512_keypair_derand(s_pk512, s_sk512, s_coins) != 0 ||
        mlkem512_enc_derand(s_ct512, s_ss, s_pk512, s_msg) != 0 ||
        mlkem768_keypair_derand(s_pk768, s_sk768, s_coins) != 0 ||
        mlkem768_enc_derand(s_ct768, s_ss, s_pk768, s_msg) != 0) {
        printf("setup failed - refusing to report numbers\n");
        return;
    }

    bool classical = classical_setup();

    bench_print_header();

    run_one("ML-KEM-512 keygen", op_kem512_keygen);
    run_one("ML-KEM-512 encaps", op_kem512_encaps);
    run_one("ML-KEM-512 decaps", op_kem512_decaps);
    run_one("ML-KEM-768 keygen", op_kem768_keygen);
    run_one("ML-KEM-768 encaps", op_kem768_encaps);
    run_one("ML-KEM-768 decaps", op_kem768_decaps);

    if (classical) {
        run_one("X25519 keygen (ecp)", op_x25519_keygen);
        run_one("X25519 derive (ecp)", op_x25519_derive);
        run_one("X25519 exchange (ecdh)", op_x25519_full_exchange);
    }

    printf("\nat %d MHz, 1 ms = %d cycles\n", CPU_MHZ, CPU_MHZ * 1000);
    printf("min is the cleanest estimate of computation; the spread is the\n"
           "%d Hz FreeRTOS tick landing inside some measurement windows.\n",
           CONFIG_FREERTOS_HZ);
    printf("\nsizes: ML-KEM-512 pk=%d ct=%d sk=%d\n", MLKEM512_PUBLICKEYBYTES,
           MLKEM512_CIPHERTEXTBYTES, MLKEM512_SECRETKEYBYTES);
    printf("       ML-KEM-768 pk=%d ct=%d sk=%d\n", MLKEM768_PUBLICKEYBYTES,
           MLKEM768_CIPHERTEXTBYTES, MLKEM768_SECRETKEYBYTES);
    printf("       X25519     pk=32 ct=32 sk=32\n");
    printf("\nbenchmark complete\n");
}
